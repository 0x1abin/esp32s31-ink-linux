## Config.in
```kconfig
menu "esp32s31-ink-linux"
config BR2_ESP32S31_INK_LINUX_PLATFORM_SUPPORT
	bool "ESP32-S31 platform integration"
	depends on BR2_RISCV_32
	help
	  Enable the ESP32-S31 kernel and boot integration selected by board defconfigs.

source "$BR2_EXTERNAL_ESP32S31_INK_LINUX_PATH/package/dropbear-client-only/Config.in"
source "$BR2_EXTERNAL_ESP32S31_INK_LINUX_PATH/package/libvterm/Config.in"
source "$BR2_EXTERNAL_ESP32S31_INK_LINUX_PATH/package/metalio-epd/Config.in"
source "$BR2_EXTERNAL_ESP32S31_INK_LINUX_PATH/package/esp32s31-linux-companion/Config.in"
source "$BR2_EXTERNAL_ESP32S31_INK_LINUX_PATH/package/esp-linux-bsp/Config.in"
endmenu
```

## board/metalio/eink4-plus/wifi/sdkconfig.defaults
```kconfig
# SPDX-License-Identifier: BSD-2-Clause
CONFIG_IDF_TARGET="esp32s31"
CONFIG_FREERTOS_UNICORE=y
CONFIG_ESP_SYSTEM_SINGLE_CORE_MODE=y
CONFIG_ESP_DEFAULT_CPU_FREQ_MHZ_320=y
CONFIG_ESPTOOLPY_FLASHSIZE_16MB=y
CONFIG_ESPTOOLPY_FLASHMODE_QIO=y
CONFIG_ESPTOOLPY_FLASHFREQ_80M=y
CONFIG_PARTITION_TABLE_CUSTOM=y
CONFIG_PARTITION_TABLE_CUSTOM_FILENAME="partitions.csv"
CONFIG_PARTITION_TABLE_OFFSET=0x8000
CONFIG_SPIRAM=y
CONFIG_SPIRAM_MODE_OCT=y
CONFIG_SPIRAM_SPEED_250M=y
CONFIG_SPIRAM_BOOT_HW_INIT=y
CONFIG_SPIRAM_BOOT_INIT=y
CONFIG_SPIRAM_USE_MEMMAP=y
# CONFIG_SPIRAM_MEMTEST is not set
CONFIG_ESP_CONSOLE_UART_DEFAULT=y
CONFIG_ESP_CONSOLE_SECONDARY_USB_SERIAL_JTAG=y
# CONFIG_ESP_PHY_CALIBRATION_AND_DATA_STORAGE is not set
CONFIG_ESP_USB_HOST_INTERFACE=y
# CONFIG_BT_ENABLED is not set
# CONFIG_ESP_HOSTED_RCP is not set
CONFIG_COMPILER_OPTIMIZATION_SIZE=y
# CONFIG_ESP_WIFI_SLP_IRAM_OPT is not set
# CONFIG_ESP_WIFI_NVS_ENABLED is not set
# CONFIG_ESP_WIFI_ENABLE_WPA3_SAE is not set
# CONFIG_ESP_WIFI_ENABLE_WPA3_OWE_STA is not set
# CONFIG_ESP_WIFI_ENABLE_WPA3_OWE_SOFTAP is not set
# CONFIG_ESP_WIFI_ENTERPRISE_SUPPORT is not set
CONFIG_SPI_FLASH_AUTO_SUSPEND=y
CONFIG_SPI_FLASH_SUSPEND_TSUS_VAL_US=50
CONFIG_SPI_FLASH_SUSPEND_TRS_VAL_US=100
# CONFIG_SPI_FLASH_SOFTWARE_RESUME is not set
# CONFIG_SPI_FLASH_FORCE_ENABLE_XMC_C_SUSPEND is not set
```

## configs/metalio_eink4_plus_defconfig
```kconfig
BR2_riscv=y
BR2_ESP32S31_INK_LINUX_PLATFORM_SUPPORT=y
BR2_riscv_custom=y
BR2_RISCV_ISA_RVM=y
BR2_RISCV_ISA_RVA=y
BR2_RISCV_ISA_RVC=y
BR2_RISCV_32=y
BR2_TOOLCHAIN_EXTERNAL=y
BR2_TOOLCHAIN_EXTERNAL_DOWNLOAD=y
BR2_TOOLCHAIN_EXTERNAL_URL="https://dl.espressif.com/dl/toolchains/preview/riscv64/14.1.1_20260922/riscv64-esp-linux-musl-14.1.1_20260922-$(HOSTARCH)-linux-gnu.tar.xz"
BR2_TOOLCHAIN_EXTERNAL_CUSTOM_PREFIX="riscv64-esp-linux-musl"
BR2_TOOLCHAIN_EXTERNAL_GCC_14=y
BR2_TOOLCHAIN_EXTERNAL_HEADERS_6_6=y
BR2_TOOLCHAIN_EXTERNAL_CUSTOM_MUSL=y
BR2_TOOLCHAIN_EXTERNAL_CXX=y
BR2_TARGET_GENERIC_HOSTNAME="metalio"
BR2_TARGET_GENERIC_ISSUE="esp32s31-ink-linux"
BR2_GLOBAL_PATCH_DIR="$(BR2_EXTERNAL_ESP32S31_INK_LINUX_PATH)/patches"
BR2_PACKAGE_OVERRIDE_FILE="$(BR2_EXTERNAL_ESP32S31_INK_LINUX_PATH)/board/metalio/eink4-plus/local.mk"
# BR2_TARGET_GENERIC_GETTY is not set
BR2_ROOTFS_OVERLAY="$(BR2_EXTERNAL_ESP32S31_INK_LINUX_PATH)/board/metalio/eink4-plus/rootfs_overlay"
BR2_ROOTFS_POST_FAKEROOT_SCRIPT="$(BR2_EXTERNAL_ESP32S31_INK_LINUX_PATH)/board/metalio/eink4-plus/rootfs-cramfs.sh"
BR2_ROOTFS_POST_IMAGE_SCRIPT="$(BR2_EXTERNAL_ESP32S31_INK_LINUX_PATH)/board/metalio/eink4-plus/post-image.sh"
BR2_LINUX_KERNEL=y
BR2_LINUX_KERNEL_CUSTOM_GIT=y
BR2_LINUX_KERNEL_CUSTOM_REPO_URL="https://github.com/espressif/linux.git"
BR2_LINUX_KERNEL_CUSTOM_REPO_VERSION="b3bd414d03b8eebb2e44edf08c86058d55e403b3"
BR2_LINUX_KERNEL_DEFCONFIG="esp32s31_minimal"
BR2_LINUX_KERNEL_CONFIG_FRAGMENT_FILES="$(BR2_EXTERNAL_ESP32S31_INK_LINUX_PATH)/board/metalio/eink4-plus/linux.config"
BR2_LINUX_KERNEL_IMAGE_TARGET_CUSTOM=y
BR2_LINUX_KERNEL_IMAGE_TARGET_NAME="xipImage"
BR2_LINUX_KERNEL_DTS_SUPPORT=y
BR2_LINUX_KERNEL_CUSTOM_DTS_DIR="$(BR2_EXTERNAL_ESP32S31_INK_LINUX_PATH)/board/metalio/eink4-plus/dts"
BR2_TARGET_ROOTFS_CPIO=y
BR2_TARGET_ROOTFS_CPIO_GZIP=y
BR2_TARGET_OPENSBI=y
BR2_TARGET_OPENSBI_CUSTOM_GIT=y
BR2_TARGET_OPENSBI_CUSTOM_REPO_URL="https://github.com/espressif/opensbi.git"
BR2_TARGET_OPENSBI_CUSTOM_REPO_VERSION="5395e03e1cb295257142cfdeaade6334f1543bcb"
BR2_TARGET_OPENSBI_PLAT="generic"
BR2_TARGET_OPENSBI_ADDITIONAL_VARIABLES="PLATFORM_DEFCONFIG=esp32s31_defconfig PLATFORM_RISCV_XLEN=32"
BR2_TARGET_UBOOT=y
BR2_TARGET_UBOOT_BUILD_SYSTEM_KCONFIG=y
BR2_TARGET_UBOOT_CUSTOM_GIT=y
BR2_TARGET_UBOOT_CUSTOM_REPO_URL="https://github.com/espressif/u-boot.git"
BR2_TARGET_UBOOT_CUSTOM_REPO_VERSION="333c7a31f49d0ecc796edc7b6f7d44c4fcd1e9f8"
BR2_TARGET_UBOOT_BOARD_DEFCONFIG="espressif_esp32s31"
BR2_TARGET_UBOOT_CONFIG_FRAGMENT_FILES="$(BR2_EXTERNAL_ESP32S31_INK_LINUX_PATH)/board/metalio/eink4-plus/uboot.config"
BR2_TARGET_UBOOT_NEEDS_OPENSBI=y
BR2_TARGET_UBOOT_USE_BINMAN=y
BR2_TARGET_UBOOT_FORMAT_DTB=y
BR2_TARGET_UBOOT_FORMAT_ITB=y
BR2_TARGET_UBOOT_SPL=y
BR2_TARGET_UBOOT_SPL_NAME="spl/u-boot-spl-dtb.bin"
BR2_PACKAGE_HOST_CRAMFS=y
BR2_PACKAGE_HOST_ESP_LINUX_BSP=y
BR2_PACKAGE_METALIO_EPD=y
BR2_PACKAGE_MEMTESTER=y
BR2_PACKAGE_DROPBEAR_CLIENT_ONLY=y
```

## configs/metalio_eink4_plus_wifi_defconfig
```kconfig
BR2_riscv=y
BR2_ESP32S31_INK_LINUX_PLATFORM_SUPPORT=y
BR2_riscv_custom=y
BR2_RISCV_ISA_RVM=y
BR2_RISCV_ISA_RVA=y
BR2_RISCV_ISA_RVC=y
BR2_RISCV_32=y
BR2_TOOLCHAIN_EXTERNAL=y
BR2_TOOLCHAIN_EXTERNAL_DOWNLOAD=y
BR2_TOOLCHAIN_EXTERNAL_URL="https://dl.espressif.com/dl/toolchains/preview/riscv64/14.1.1_20260922/riscv64-esp-linux-musl-14.1.1_20260922-$(HOSTARCH)-linux-gnu.tar.xz"
BR2_TOOLCHAIN_EXTERNAL_CUSTOM_PREFIX="riscv64-esp-linux-musl"
BR2_TOOLCHAIN_EXTERNAL_GCC_14=y
BR2_TOOLCHAIN_EXTERNAL_HEADERS_6_6=y
BR2_TOOLCHAIN_EXTERNAL_CUSTOM_MUSL=y
BR2_TOOLCHAIN_EXTERNAL_CXX=y
BR2_TARGET_GENERIC_HOSTNAME="metalio"
BR2_TARGET_GENERIC_ISSUE="esp32s31-ink-linux"
BR2_GLOBAL_PATCH_DIR="$(BR2_EXTERNAL_ESP32S31_INK_LINUX_PATH)/patches"
BR2_PACKAGE_OVERRIDE_FILE="$(BR2_EXTERNAL_ESP32S31_INK_LINUX_PATH)/board/metalio/eink4-plus/local.mk"
# BR2_TARGET_GENERIC_GETTY is not set
BR2_ROOTFS_OVERLAY="$(BR2_EXTERNAL_ESP32S31_INK_LINUX_PATH)/board/metalio/eink4-plus/rootfs_overlay $(BR2_EXTERNAL_ESP32S31_INK_LINUX_PATH)/board/metalio/eink4-plus/wifi/rootfs_overlay"
BR2_ROOTFS_POST_FAKEROOT_SCRIPT="$(BR2_EXTERNAL_ESP32S31_INK_LINUX_PATH)/board/metalio/eink4-plus/wifi/rootfs-cramfs.sh"
BR2_ROOTFS_POST_IMAGE_SCRIPT="$(BR2_EXTERNAL_ESP32S31_INK_LINUX_PATH)/board/metalio/eink4-plus/wifi/post-image.sh"
BR2_LINUX_KERNEL=y
BR2_LINUX_KERNEL_CUSTOM_GIT=y
BR2_LINUX_KERNEL_CUSTOM_REPO_URL="https://github.com/espressif/linux.git"
BR2_LINUX_KERNEL_CUSTOM_REPO_VERSION="b3bd414d03b8eebb2e44edf08c86058d55e403b3"
BR2_LINUX_KERNEL_DEFCONFIG="esp32s31_minimal"
BR2_LINUX_KERNEL_CONFIG_FRAGMENT_FILES="$(BR2_EXTERNAL_ESP32S31_INK_LINUX_PATH)/board/metalio/eink4-plus/linux.config $(BR2_EXTERNAL_ESP32S31_INK_LINUX_PATH)/board/metalio/eink4-plus/wifi/linux.config"
BR2_LINUX_KERNEL_IMAGE_TARGET_CUSTOM=y
BR2_LINUX_KERNEL_IMAGE_TARGET_NAME="xipImage"
BR2_LINUX_KERNEL_DTS_SUPPORT=y
BR2_LINUX_KERNEL_CUSTOM_DTS_DIR="$(BR2_EXTERNAL_ESP32S31_INK_LINUX_PATH)/board/metalio/eink4-plus/dts $(BR2_EXTERNAL_ESP32S31_INK_LINUX_PATH)/board/metalio/eink4-plus/wifi/dts"
BR2_LINUX_KERNEL_INTREE_DTS_NAME="espressif/metalio-eink4-plus-wifi"
BR2_TARGET_ROOTFS_CPIO=y
BR2_TARGET_ROOTFS_CPIO_GZIP=y
BR2_TARGET_OPENSBI=y
BR2_TARGET_OPENSBI_CUSTOM_GIT=y
BR2_TARGET_OPENSBI_CUSTOM_REPO_URL="https://github.com/espressif/opensbi.git"
BR2_TARGET_OPENSBI_CUSTOM_REPO_VERSION="5395e03e1cb295257142cfdeaade6334f1543bcb"
BR2_TARGET_OPENSBI_PLAT="esp32s31"
BR2_TARGET_OPENSBI_ADDITIONAL_VARIABLES="PLATFORM_RISCV_XLEN=32 ESP32S31_INK_LINUX_SHARED_DIR=$(BR2_EXTERNAL_ESP32S31_INK_LINUX_PATH)/shared"
# BR2_TARGET_OPENSBI_INSTALL_DYNAMIC_IMG is not set
BR2_TARGET_OPENSBI_INSTALL_JUMP_IMG=y
BR2_PACKAGE_HOST_CRAMFS=y
BR2_PACKAGE_HOST_DTC=y
BR2_PACKAGE_METALIO_EPD=y
BR2_PACKAGE_MEMTESTER=y
BR2_PACKAGE_DROPBEAR_CLIENT_ONLY=y
BR2_PACKAGE_ESP32S31_LINUX_COMPANION=y
BR2_PACKAGE_HOST_MTD=y
BR2_PACKAGE_BUSYBOX_CONFIG_FRAGMENT_FILES="$(BR2_EXTERNAL_ESP32S31_INK_LINUX_PATH)/board/metalio/eink4-plus/wifi/busybox.config"
BR2_PACKAGE_ESP32S31_LINUX_COMPANION_BOARD_DIR="$(BR2_EXTERNAL_ESP32S31_INK_LINUX_PATH)/board/metalio/eink4-plus/wifi"
```

## firmware/esp32s31-linux-companion/components/esp_hosted/Kconfig.projbuild
```kconfig
# SPDX-License-Identifier: Apache-2.0
orsource "$ESP32S31_INK_LINUX_HOSTED_PATH/esp/esp_driver/network_adapter/main/Kconfig.projbuild"
```

## kernel/Kconfig
```kconfig
config METALIO_EPD
	tristate "Metalio E-Ink4 Plus ESP32-S31 parallel panel"
	depends on OF && HAS_DMA && I2C && GPIOLIB
	select MFD_SYSCON
	help
	  Native E0470A14-AF scanning using exclusive LCD-CAM, AXI-DMA TX0
	  and RMT channel 0. Exposes /dev/metalio-epd. The DT must disable
	  other consumers of those peripherals and of the panel pins.

config METALIO_EPD_FAST_REFRESH
	bool "Metalio DU14 and short keyboard feedback"
	depends on METALIO_EPD
	default y
	help
	  Use DU14 and FOLLOW8 binary endpoints and reuse adjacent identical
	  phase data. Disable to restore DU20 without short feedback. Both
	  choices use the original 20 MHz / 17 us scan timing and a minimum
	  12 ms phase start-to-start interval.

config TOUCHSCREEN_METALIO_FT6336U
	tristate "Metalio E-Ink4 Plus FT6336U touchscreen and Enter keys"
	depends on OF && I2C && GPIOLIB && INPUT
	help
	  Board-specific FT6336U portrait touchscreen and three capacitive
	  keys: left confirm requests a refresh, page keys report Enter.
	  Requires the Metalio reset and IRQ pins.
```

## kernel/esp32s31-hosted/Kconfig
```kconfig
# SPDX-License-Identifier: GPL-2.0-only
config ESP32S31_HOSTED
	bool "Metalio ESP32-S31 ESP-Hosted shared-memory Wi-Fi"
	depends on ARCH_ESPRESSIF && ESP_CLIC && OF && CFG80211=y && MTD=y
	depends on BT != m
	help
	  Linux runs on CPU1; CPU0 runs the matching ESP-IDF Wi-Fi firmware.
	  Exposes cfg80211 station networking and only the data flash partition.
```

## package/dropbear-client-only/Config.in
```kconfig
config BR2_PACKAGE_DROPBEAR_CLIENT_ONLY
	bool "Dropbear SSH client"
	depends on !BR2_PACKAGE_DROPBEAR
	depends on !BR2_PACKAGE_OPENSSH_CLIENT
	help
	  Build only dbclient and provide an ssh command alias.
	  No SSH server or startup service is installed.

	  https://matt.ucc.asn.au/dropbear/dropbear.html
```

## package/esp32s31-linux-companion/Config.in
```kconfig
config BR2_PACKAGE_ESP32S31_LINUX_COMPANION
	bool "ESP32-S31 Linux companion firmware and persistent configuration"
	depends on BR2_LINUX_KERNEL
	depends on BR2_RISCV_32
	depends on BR2_ESP32S31_INK_LINUX_PLATFORM_SUPPORT
	select BR2_PACKAGE_WPA_SUPPLICANT
	select BR2_PACKAGE_WPA_SUPPLICANT_NL80211
	select BR2_PACKAGE_WPA_SUPPLICANT_CLI
	select BR2_PACKAGE_WPA_SUPPLICANT_PASSPHRASE
	select BR2_PACKAGE_IFUPDOWN_SCRIPTS
	help
	  ESP-Hosted on CPU0 with Linux on CPU1, WPA2 station networking and
	  an independent JFFS2 data partition. Use the Wi-Fi board defconfig.

config BR2_PACKAGE_ESP32S31_LINUX_COMPANION_BOARD_DIR
	string "Companion firmware board configuration directory"
	depends on BR2_PACKAGE_ESP32S31_LINUX_COMPANION
	help
	  Directory containing sdkconfig.defaults and partitions.csv for the board.
```

## package/libvterm/Config.in
```kconfig
config BR2_PACKAGE_LIBVTERM
	bool "libvterm"
	help
	  Small terminal emulator library for the local e-paper terminal.
	  https://www.leonerd.org.uk/code/libvterm/
```

## package/metalio-epd/Config.in
```kconfig
config BR2_PACKAGE_METALIO_EPD
	bool "Metalio native e-paper driver, demo and terminal"
	depends on BR2_LINUX_KERNEL
	select BR2_PACKAGE_LIBVTERM
	help
	  Installs the board kernel driver, a test-pattern demo, and a local
	  shell terminal with a touch keyboard.
```

## platform/esp32s31/opensbi/configs/defconfig
```kconfig
CONFIG_SMCLIC=y
# CONFIG_SMDBLTRP is not set
# CONFIG_SBI_ECALL_FWFT is not set
# CONFIG_SBI_ECALL_DBTR is not set
# CONFIG_SBI_ECALL_SSE is not set
```
